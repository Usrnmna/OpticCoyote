#pragma once

#include <avr/pgmspace.h>
#include "display_protocol.h"

// Fixed raster font for the distance row only. Labels and units retain the
// default GFX font. Each row uses bits 8..0 from left to right; the decimal
// point uses only bits 8..6. Flash storage avoids consuming Nano SRAM.
namespace DistanceGlyphs {
constexpr uint8_t kColumnWidth = 32;
constexpr uint8_t kValueTop = 8;
constexpr uint8_t kHeight = 16;
constexpr uint8_t kDigitWidth = 9;
constexpr uint8_t kDotWidth = 3;
constexpr uint8_t kSpacing = 1;
static_assert(3 * kDigitWidth + 2 * kSpacing <= kColumnWidth,
              "The capped distance must fit one sensor column");
static_assert(kValueTop + kHeight <= 24, "Leave row 24 clear above the footer");

const uint16_t kRows[][kHeight] PROGMEM = {
  // 0
  {0x07C, 0x0FE, 0x1C7, 0x183, 0x183, 0x183, 0x183, 0x183,
   0x183, 0x183, 0x183, 0x183, 0x183, 0x1C7, 0x0FE, 0x07C},
  // 1
  {0x018, 0x038, 0x078, 0x0D8, 0x018, 0x018, 0x018, 0x018,
   0x018, 0x018, 0x018, 0x018, 0x018, 0x018, 0x1FF, 0x1FF},
  // 2
  {0x0FE, 0x1FF, 0x183, 0x003, 0x003, 0x007, 0x00E, 0x01C,
   0x038, 0x070, 0x0E0, 0x1C0, 0x180, 0x180, 0x1FF, 0x1FF},
  // 3
  {0x0FE, 0x1FF, 0x183, 0x003, 0x003, 0x007, 0x03E, 0x03E,
   0x007, 0x003, 0x003, 0x003, 0x183, 0x1C7, 0x0FE, 0x07C},
  // 4
  {0x00E, 0x01E, 0x036, 0x066, 0x0C6, 0x186, 0x186, 0x186,
   0x1FF, 0x1FF, 0x006, 0x006, 0x006, 0x006, 0x006, 0x006},
  // 5
  {0x1FF, 0x1FF, 0x180, 0x180, 0x180, 0x180, 0x1FC, 0x1FE,
   0x007, 0x003, 0x003, 0x003, 0x183, 0x1C7, 0x0FE, 0x07C},
  // 6
  {0x03E, 0x07E, 0x0E0, 0x1C0, 0x180, 0x180, 0x1FC, 0x1FE,
   0x1C7, 0x183, 0x183, 0x183, 0x183, 0x1C7, 0x0FE, 0x07C},
  // 7
  {0x1FF, 0x1FF, 0x003, 0x007, 0x006, 0x00E, 0x00C, 0x01C,
   0x018, 0x038, 0x030, 0x030, 0x060, 0x060, 0x060, 0x060},
  // 8
  {0x07C, 0x0FE, 0x1C7, 0x183, 0x183, 0x1C7, 0x0FE, 0x07C,
   0x0FE, 0x1C7, 0x183, 0x183, 0x183, 0x1C7, 0x0FE, 0x07C},
  // 9
  {0x07C, 0x0FE, 0x1C7, 0x183, 0x183, 0x183, 0x1C7, 0x0FF,
   0x07F, 0x003, 0x003, 0x007, 0x00E, 0x01C, 0x0F8, 0x0F0},
  // -
  {0x000, 0x000, 0x000, 0x000, 0x000, 0x000, 0x000, 0x1FF,
   0x1FF, 0x000, 0x000, 0x000, 0x000, 0x000, 0x000, 0x000},
  // .
  {0x000, 0x000, 0x000, 0x000, 0x000, 0x000, 0x000, 0x000,
   0x000, 0x000, 0x000, 0x000, 0x000, 0x1C0, 0x1C0, 0x1C0},
  // Greater-than-or-equal: upper chevron plus lower equality bar.
  {0x180, 0x1E0, 0x078, 0x01E, 0x007, 0x007, 0x01E, 0x078,
   0x1E0, 0x180, 0x000, 0x000, 0x1FF, 0x1FF, 0x000, 0x000},
};

inline uint8_t glyphIndex(char symbol) {
  if (symbol >= '0' && symbol <= '9') return symbol - '0';
  if (symbol == '.') return 11;
  if (symbol == DisplayProtocol::kAtLeastGlyph) return 12;
  return 10;  // Unrecognized symbols use the unavailable dash.
}

inline uint8_t glyphWidth(char symbol) {
  return symbol == '.' ? kDotWidth : kDigitWidth;
}

// The formatter always supplies three symbols. Narrow decimal points produce
// 23-pixel fields; the capped value occupies 29 pixels. Center both in 32 pixels.
inline uint8_t valueWidth(const char (&text)[5]) {
  return glyphWidth(text[0]) + glyphWidth(text[1]) + glyphWidth(text[2]) +
      2 * kSpacing;
}

// Draw into the cleared framebuffer; no heap allocation or per-glyph transfer.
// The private '>' token selects the complete >= symbol, not the default font.
template <typename Display>
void drawValue(Display &display, uint8_t columnLeft, const char (&text)[5]) {
  uint8_t left = columnLeft + (kColumnWidth - valueWidth(text)) / 2;
  for (uint8_t symbol = 0; symbol < 3; ++symbol) {
    const uint8_t index = glyphIndex(text[symbol]);
    const uint8_t width = glyphWidth(text[symbol]);
    for (uint8_t row = 0; row < kHeight; ++row) {
      const uint16_t bits = pgm_read_word(&kRows[index][row]);
      for (uint8_t column = 0; column < width; ++column) {
        if (bits & (0x100U >> column))
          display.drawPixel(left + column, kValueTop + row, 1);
      }
    }
    left += width + kSpacing;
  }
}
}  // namespace DistanceGlyphs
